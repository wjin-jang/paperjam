## paperjam-os/Config.in
```kconfig
# PaperJam OS External Configuration

menu "PaperJam OS packages"

source "$BR2_EXTERNAL_PAPERJAM_PATH/package/paperjam/Config.in"
source "$BR2_EXTERNAL_PAPERJAM_PATH/package/waveshare-epd/Config.in"
source "$BR2_EXTERNAL_PAPERJAM_PATH/package/python-evdev/Config.in"

endmenu
```

## paperjam-os/configs/paperjam_defconfig
```kconfig
# PaperJam OS Buildroot Configuration
# Target: Raspberry Pi Zero 2 W with e-paper display and battery module

# ============================================================
# Target Architecture
# ============================================================
BR2_arm=y
BR2_cortex_a53=y
BR2_ARM_FPU_NEON_VFPV4=y

# ============================================================
# Toolchain
# ============================================================
BR2_TOOLCHAIN_BUILDROOT_GLIBC=y
BR2_TOOLCHAIN_BUILDROOT_CXX=y

# ============================================================
# Build Options
# ============================================================
BR2_CCACHE=y
BR2_OPTIMIZE_2=y

# ============================================================
# System Configuration
# ============================================================
BR2_TARGET_GENERIC_HOSTNAME="paperjam"
BR2_TARGET_GENERIC_ISSUE="Welcome to PaperJam OS"
BR2_INIT_BUSYBOX=y
BR2_SYSTEM_BIN_SH_BUSYBOX=y

# Root password (change in production!)
BR2_TARGET_GENERIC_ROOT_PASSWD="paperjam"

# Enable /dev management with mdev
BR2_ROOTFS_DEVICE_CREATION_DYNAMIC_MDEV=y

# Timezone
BR2_TARGET_LOCALTIME="UTC"

# ============================================================
# Linux Kernel
# ============================================================
BR2_LINUX_KERNEL=y
BR2_LINUX_KERNEL_CUSTOM_TARBALL=y
BR2_LINUX_KERNEL_CUSTOM_TARBALL_LOCATION="https://github.com/raspberrypi/linux/archive/refs/tags/stable_20231123.tar.gz"
BR2_LINUX_KERNEL_DEFCONFIG="bcm2711"
BR2_LINUX_KERNEL_DTS_SUPPORT=y
BR2_LINUX_KERNEL_INTREE_DTS_NAME="broadcom/bcm2710-rpi-zero-2-w"
BR2_LINUX_KERNEL_NEEDS_HOST_OPENSSL=y

# Kernel image format
BR2_LINUX_KERNEL_IMAGE_TARGET_CUSTOM=y
BR2_LINUX_KERNEL_IMAGE_TARGET_NAME="Image"

# ============================================================
# Raspberry Pi Firmware
# ============================================================
BR2_PACKAGE_RPI_FIRMWARE=y
BR2_PACKAGE_RPI_FIRMWARE_VARIANT_PI=y
BR2_PACKAGE_RPI_FIRMWARE_CONFIG_FILE="$(BR2_EXTERNAL_PAPERJAM_PATH)/board/paperjam/config.txt"

# ============================================================
# Filesystem
# ============================================================
BR2_TARGET_ROOTFS_EXT2=y
BR2_TARGET_ROOTFS_EXT2_4=y
BR2_TARGET_ROOTFS_EXT2_SIZE="256M"
BR2_ROOTFS_OVERLAY="$(BR2_EXTERNAL_PAPERJAM_PATH)/board/paperjam/overlay"
BR2_ROOTFS_POST_BUILD_SCRIPT="$(BR2_EXTERNAL_PAPERJAM_PATH)/board/paperjam/post-build.sh"
BR2_ROOTFS_POST_IMAGE_SCRIPT="$(BR2_EXTERNAL_PAPERJAM_PATH)/board/paperjam/post-image.sh"

# ============================================================
# Audio Stack
# ============================================================
BR2_PACKAGE_ALSA_LIB=y
BR2_PACKAGE_ALSA_LIB_MIXER=y
BR2_PACKAGE_ALSA_LIB_PCM=y
BR2_PACKAGE_ALSA_UTILS=y
BR2_PACKAGE_ALSA_UTILS_AMIXER=y
BR2_PACKAGE_ALSA_UTILS_APLAY=y

BR2_PACKAGE_PULSEAUDIO=y
BR2_PACKAGE_PULSEAUDIO_DAEMON=y

BR2_PACKAGE_VLC=y
BR2_PACKAGE_VLC_ALSA=y
BR2_PACKAGE_VLC_PULSE=y
BR2_PACKAGE_VLC_FLAC=y
BR2_PACKAGE_VLC_VORBIS=y
BR2_PACKAGE_VLC_MAD=y
BR2_PACKAGE_VLC_FAAD2=y
# Disable video features
# BR2_PACKAGE_VLC_V4L2 is not set
# BR2_PACKAGE_VLC_X264 is not set

# ============================================================
# Bluetooth
# ============================================================
BR2_PACKAGE_BLUEZ5_UTILS=y
BR2_PACKAGE_BLUEZ5_UTILS_OBEX=y
BR2_PACKAGE_BLUEZ5_UTILS_PLUGINS_AUDIO=y
BR2_PACKAGE_BLUEZ5_UTILS_PLUGINS_HEALTH=y

# ============================================================
# Networking
# ============================================================
BR2_PACKAGE_DBUS=y
BR2_PACKAGE_DBUS_GLIB=y
BR2_PACKAGE_DHCPCD=y
BR2_PACKAGE_IW=y
BR2_PACKAGE_RFKILL=y
BR2_PACKAGE_WIRELESS_TOOLS=y
BR2_PACKAGE_WPA_SUPPLICANT=y
BR2_PACKAGE_WPA_SUPPLICANT_CLI=y
BR2_PACKAGE_WPA_SUPPLICANT_DBUS=y
BR2_PACKAGE_WPA_SUPPLICANT_NL80211=y
BR2_PACKAGE_WPA_SUPPLICANT_WPS=y

# ============================================================
# Python 3
# ============================================================
BR2_PACKAGE_PYTHON3=y
BR2_PACKAGE_PYTHON3_PY_PYC=y
BR2_PACKAGE_PYTHON3_SQLITE=y
BR2_PACKAGE_PYTHON3_SSL=y

# Python packages
BR2_PACKAGE_PYTHON_DBUS=y
BR2_PACKAGE_PYTHON_GOBJECT=y
BR2_PACKAGE_PYTHON_NUMPY=y
BR2_PACKAGE_PYTHON_PILLOW=y
BR2_PACKAGE_PYTHON_PYYAML=y
BR2_PACKAGE_PYTHON_MUTAGEN=y

# ============================================================
# Hardware Support
# ============================================================
BR2_PACKAGE_I2C_TOOLS=y
BR2_PACKAGE_LIBGPIOD=y
BR2_PACKAGE_LIBGPIOD_TOOLS=y
BR2_PACKAGE_PYTHON_LIBGPIOD=y
BR2_PACKAGE_SPIDEV_TEST=y

# ============================================================
# System Utilities
# ============================================================
BR2_PACKAGE_BUSYBOX=y
BR2_PACKAGE_BUSYBOX_CONFIG="$(BR2_EXTERNAL_PAPERJAM_PATH)/board/paperjam/busybox.config"
BR2_PACKAGE_UTIL_LINUX=y
BR2_PACKAGE_UTIL_LINUX_MOUNT=y
BR2_PACKAGE_HTOP=y

# ============================================================
# Debugging (disable in production)
# ============================================================
BR2_PACKAGE_DROPBEAR=y
BR2_ENABLE_DEBUG=n

# ============================================================
# Custom Packages
# ============================================================
BR2_PACKAGE_PAPERJAM=y
BR2_PACKAGE_WAVESHARE_EPD=y
BR2_PACKAGE_PYTHON_EVDEV=y

# ============================================================
# Host Tools for Image Generation
# ============================================================
BR2_PACKAGE_HOST_DOSFSTOOLS=y
BR2_PACKAGE_HOST_E2FSPROGS=y
BR2_PACKAGE_HOST_GENIMAGE=y
BR2_PACKAGE_HOST_MTOOLS=y
```

## paperjam-os/package/paperjam/Config.in
```kconfig
config BR2_PACKAGE_PAPERJAM
	bool "paperjam"
	depends on BR2_PACKAGE_PYTHON3
	select BR2_PACKAGE_PYTHON_PILLOW
	select BR2_PACKAGE_PYTHON_PYYAML
	select BR2_PACKAGE_PYTHON_MUTAGEN
	select BR2_PACKAGE_PYTHON_DBUS
	select BR2_PACKAGE_PYTHON_EVDEV
	select BR2_PACKAGE_PYTHON_LIBGPIOD
	select BR2_PACKAGE_VLC
	select BR2_PACKAGE_WAVESHARE_EPD
	help
	  PaperJam - E-ink music player application for Raspberry Pi.

	  Features:
	  - Music library browsing (Artist/Album/Track)
	  - VLC-based audio playback
	  - Bluetooth audio output
	  - Waveshare e-Paper display support
	  - PiSugar 3 battery monitoring

	  https://github.com/your-repo/paperjam
```

## paperjam-os/package/python-evdev/Config.in
```kconfig
config BR2_PACKAGE_PYTHON_EVDEV
	bool "python-evdev"
	depends on BR2_PACKAGE_PYTHON3
	help
	  Python bindings for the Linux input subsystem.

	  Provides access to input devices (keyboard, mouse,
	  touchscreen, etc.) via /dev/input/event* devices.

	  https://python-evdev.readthedocs.io/
```

## paperjam-os/package/waveshare-epd/Config.in
```kconfig
config BR2_PACKAGE_WAVESHARE_EPD
	bool "waveshare-epd"
	depends on BR2_PACKAGE_PYTHON3
	select BR2_PACKAGE_PYTHON_PILLOW
	select BR2_PACKAGE_PYTHON_SPIDEV
	select BR2_PACKAGE_PYTHON_LIBGPIOD
	help
	  Waveshare e-Paper display driver library for Python.

	  Supports:
	  - 2.13" V4 e-Paper (250x122)
	  - SPI interface
	  - Partial and full refresh modes

	  https://github.com/waveshare/e-Paper
```
